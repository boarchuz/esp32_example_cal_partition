## components/bo_phycp/Kconfig
```kconfig
menu "[BO] PHY Calibration Partition"

    config BO_PHYCP_ENABLED
        bool "Enable"
        default n
        help
            Override default phy calibration with storage/retrieval of calibration data from flash partition.

            Warning: This will enable the linker option for multiple symbol definitions, in order to override default functions.

    config BO_PHYCP_PARTITION_SUBTYPE
        hex "Partition subtype"
        depends on BO_PHYCP_ENABLED
        default 0xCD
        range 0x06 0xFE

endmenu
```

## sdkconfig.defaults
```kconfig
CONFIG_ESP32_PHY_MAX_WIFI_TX_POWER=10
CONFIG_ESP32_PHY_MAX_TX_POWER=10
CONFIG_ESP_WIFI_STA_DISCONNECTED_PM_ENABLE=y
CONFIG_ESP32_WIFI_NVS_ENABLED=n
CONFIG_PARTITION_TABLE_CUSTOM=y
CONFIG_PARTITION_TABLE_CUSTOM_FILENAME="partitions.csv"
CONFIG_PARTITION_TABLE_FILENAME="partitions.csv"
CONFIG_BO_PHYCP_ENABLED=y
CONFIG_BO_PHYCP_PARTITION_SUBTYPE=0xCD
```
